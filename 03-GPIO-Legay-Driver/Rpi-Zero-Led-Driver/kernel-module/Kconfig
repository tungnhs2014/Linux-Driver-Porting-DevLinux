## 03-GPIO-Legay-Driver/Rpi-Zero-Led-Driver/kernel-module/Kconfig
```kconfig
config LED_DRIVER
    tristate "LED Character Device Driver for Pi Zero W"
    depends on ARM && GPIOLIB
    default m
    help
      Character device driver for LED control on Raspberry Pi Zero W.
      Creates /dev/led device for LED control via direct register access.
```

## 03-GPIO-Legay-Driver/Rpi-Zero-Led-Driver/meta-led-layer/conf/layer.conf
```bitbake
# We have a conf and classes directory, add to BBPATH
BBPATH .= ":${LAYERDIR}"

# We have recipes-* directories, add to BBFILES
BBFILES += "${LAYERDIR}/recipes-*/*/*.bb \
            ${LAYERDIR}/recipes-*/*/*.bbappend"

BBFILE_COLLECTIONS += "meta-led-layer"
BBFILE_PATTERN_meta-led-layer = "^${LAYERDIR}/"
BBFILE_PRIORITY_meta-led-layer = "6"

LAYERDEPENDS_meta-led-layer = "core"
LAYERSERIES_COMPAT_meta-led-layer = "dunfell"
```

## 04-GPIO-Subsytem-Device-Tree/GPIO-Descriptor-base-driver/kernel-driver/Kconfig
```kconfig
menu "GPIO LED Descriptor Driver"

config GPIO_LED_DESCRIPTOR_DRIVER
	tristate "GPIO LED Descriptor Driver"
	depends on GPIOLIB && OF
	help
	  GPIO LED control driver using descriptor API with Device Tree.
	  
	  Creates /dev/gpio_led character device for userspace control.
	  Supports multiple LEDs configured via Device Tree overlay.
	  
	  To compile as module, choose M here.

endmenu
```

## 04-GPIO-Subsytem-Device-Tree/GPIO-Descriptor-base-driver/meta-gpio_descriptor/conf/layer.conf
```bitbake
# We have a conf and classes directory, add to BBPATH
BBPATH .= ":${LAYERDIR}"

# We have recipes-* directories, add to BBFILES
BBFILES += "${LAYERDIR}/recipes-*/*/*.bb \
            ${LAYERDIR}/recipes-*/*/*.bbappend"

BBFILE_COLLECTIONS += "meta-gpio_descriptor"
BBFILE_PATTERN_meta-gpio_descriptor = "^${LAYERDIR}/"
BBFILE_PRIORITY_meta-gpio_descriptor = "6"

LAYERDEPENDS_meta-gpio_descriptor = "core"
LAYERSERIES_COMPAT_meta-gpio_descriptor = "dunfell"
```

## 04-GPIO-Subsytem-Device-Tree/Integer-based-GPIO-interface/kernel-driver/Kconfig
```kconfig
config GPIO_LED_DRIVER
    tristate "GPIO LED Character Device Driver (Legacy GPIO Interface)"
    depends on ARM && GPIOLIB
    default m
    help
      Character device driver for LED control on Raspberry Pi Zero W
      using Linux GPIO subsystem (legacy integer-based GPIO interface).
      Creates /dev/gpio_led device for LED control.
```

## 04-GPIO-Subsytem-Device-Tree/Integer-based-GPIO-interface/meta-gpio-layer/conf/layer.conf
```bitbake
# We have a conf and classes directory, add to BBPATH
BBPATH .= ":${LAYERDIR}"

# We have recipes-* directories, add to BBFILES
BBFILES += "${LAYERDIR}/recipes-*/*/*.bb \
            ${LAYERDIR}/recipes-*/*/*.bbappend"

BBFILE_COLLECTIONS += "meta-gpio-layer"
BBFILE_PATTERN_meta-gpio-layer = "^${LAYERDIR}/"
BBFILE_PRIORITY_meta-gpio-layer = "6"

LAYERDEPENDS_meta-gpio-layer = "core"
LAYERSERIES_COMPAT_meta-gpio-layer = "dunfell"
```

## 05-I2C-Decice-Driver/SSD1306-Device-Driver/kernel-driver/Kconfig
```kconfig
menu "SSD1306 OLED Display Driver"

config SSD1306_OLED_DRIVER
    tristate "SSD1306 OLED Display I2C Driver"
    depends on I2C && OF
    help
      I2C driver for SSD1306 OLED display with character device interface.
      
      Creates /dev/ssd1306 character device for userspace text display.
      Supports 128x64 OLED displays via I2C communication.
      
      To compile as module, choose M here.

endmenu
```

## 05-I2C-Decice-Driver/meta-ssd1306-layer/conf/layer.conf
```bitbake
# We have a conf and classes directory, add to BBPATH
BBPATH .= ":${LAYERDIR}"

# We have recipes-* directories, add to BBFILES
BBFILES += "${LAYERDIR}/recipes-*/*/*.bb \
            ${LAYERDIR}/recipes-*/*/*.bbappend"

BBFILE_COLLECTIONS += "meta-ssd1306-layer"
BBFILE_PATTERN_meta-ssd1306-layer = "^${LAYERDIR}/"
BBFILE_PRIORITY_meta-ssd1306-layer = "6"

LAYERDEPENDS_meta-ssd1306-layer = "core"
LAYERSERIES_COMPAT_meta-ssd1306-layer = "dunfell"
```

## 06-SPI-Device-Driver/Nokia-5510-Device-Driver/kernel-driver/Kconfig
```kconfig
menu "Nokia 5110 LCD Display Driver"

config NOKIA5110_LCD_DRIVER
    tristate "Nokia 5110 LCD Display SPI Driver"
    depends on SPI && OF
    help
      SPI driver for Nokia 5110 LCD display with character device interface.
      
      Creates /dev/nokia5110 character device for userspace text display.
      Supports 84x48 LCD displays via SPI communication.
      
      To compile as module, choose M here.

endmenu
```
