/dts-v1/;
/plugin/;

/**
 * Nokia 5110 LCD Displau Device Tree Overlay
 * Hardware configuration for SPI LCD display
 * Compatible with Raspberry Pi Zero W
 */

/ {
    compatible = "brcm, bcm2708";

    fragment@0 {
        target = <&spi0>;
        __overlay__ {
            #address-cells = <1>;
            #size-cells = <0>;
            pinctrl-names = "default";
            pinctrl-0 = <&spi0_pins>;
            status = "okay";

            nokia5110_display: nokia5110@0 {
                compatible = "simple,nokia5110-lcd";
                reg = <0>;                      // SPI chip select 0
                spi-max-frequency = <4000000>;  // 4MHz SPI clock
                width = <84>;                   // display width pixels                  
                height = <48>;                  // Display height pixels

                /* GPIO pin assignments */
                reset-gpios = <&gpio 25 1>;     // GPIO25, active low
                dc-gpios = <&gpio 24 0>;        // GPIO24, active high

                status = "okay";   
            };
        };
    };
};