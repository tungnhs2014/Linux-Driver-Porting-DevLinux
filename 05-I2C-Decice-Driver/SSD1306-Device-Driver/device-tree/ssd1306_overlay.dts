/dts-v1/;
/plugin/;

/**
 * SSD1306 OLED Display Device Tree Overlay
 * Hardware configuration for I2C OLED display
 * Compatible with Raspberry Pi Zero W
 */

/ {
	compatible = "brcm, bcm2708";

	fragment@0 {
		target = <&i2c1>;
		__overlay__ {
			#address-cells = <1>;
            #size-cells = <0>;
            pinctrl-names = "default";
            pinctrl-0 = <&i2c1_pins>;
            clock-frequency = <100000>; // 100KHz I2C clock
            status = "okay";

            ssd1306_display: ssd1306@3c {
                compatible = "simple,ssd1306-oled";
                reg = <0x3c>;           // I2C address 0x3C
                width = <128>;          // Display width pixels
                height = <64>;          // Display height pixels
                status = "okay";
            };
		};
	};
};